## app/boards/my_board/board.yml
```yaml
board:
  name: my_board
  full_name: My Custom Board based on STM32F4 Discovery
  vendor: st
  socs:
    - name: stm32f407xx
```

## app/boards/our_board/board.yml
```yaml
board:
  name: our_board
  full_name: Our Custom Board based on STM32F4 Discovery
  vendor: st
  socs:
    - name: stm32f407xx
```

## led_sensor/drivers/led_sensor/Kconfig
```kconfig
menuconfig LED_SENSOR_DRIVER
	bool "Our custom LED Driver"
	default y
	depends on DT_HAS_ENGRAM_LED_SENSOR_ENABLED
  select GPIO
	help
		Enable the custom driver for GPIO
```

## led_sensor/dts/bindings/engram,led-sensor.yaml
```yaml
description: On-board LED Sensor Driver

compatible: "engram,led-sensor"

include: [sensor-device.yaml, base.yaml]

properties:
  led-gpios:
    type: phandle-array
    required: true
    description: GPIO specifier for the controlled on-board LED.
```

## tests/ring_buf/testcase.yaml
```yaml
common:
  tags:
    - unit
    - ring_buf
    - ztest
    - homework

tests:
  homework.unit.ring_buf:
    platform_allow: qemu_x86
    timeout: 60
```
